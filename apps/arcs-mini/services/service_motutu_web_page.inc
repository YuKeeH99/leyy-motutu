"<!doctype html>\n"
"<html lang='zh-CN'>\n"
"<head>\n"
"<meta charset='utf-8'>\n"
"<meta name='viewport' content='width=device-width, initial-scale=1'>\n"
"<title>Motutu Keyframe Studio</title>\n"
"<script src='https://cdn.jsdelivr.net/npm/three@0.160.0/build/three.min.js'></script>\n"
"<script src='https://cdn.jsdelivr.net/npm/three@0.160.0/examples/js/controls/OrbitControls.js'></script>\n"
"<style>\n"
":root{color-scheme:dark;--bg:#0f172a;--card:#111827;--card2:#0b1220;--line:#334155;--text:#e2e8f0;--muted:#94a3b8;--accent:#2563eb;--accent2:#0ea5e9;--ok:#16a34a;--warn:#f59e0b;}\n"
"*{box-sizing:border-box;}body{margin:0;background:linear-gradient(180deg,#0f172a,#020617);color:var(--text);font-family:Arial,sans-serif;}main{max-width:1440px;margin:0 auto;padding:16px;}h1,h2,h3{margin:0 0 12px;}small,.muted{color:var(--muted);}button,select,input,textarea{font:inherit;}button{border:0;border-radius:10px;padding:10px 14px;background:var(--accent);color:#fff;cursor:pointer;}button.secondary{background:#475569;}button.ghost{background:transparent;border:1px solid var(--line);}button.warn{background:#b45309;}input,select,textarea{width:100%;background:#020617;color:var(--text);border:1px solid var(--line);border-radius:10px;padding:10px;}textarea{min-height:180px;font-family:Consolas,monospace;}label{display:block;font-size:13px;color:var(--muted);margin-bottom:6px;}pre{margin:0;background:#020617;border:1px solid var(--line);border-radius:12px;padding:12px;white-space:pre-wrap;word-break:break-word;}table{width:100%;border-collapse:collapse;font-size:13px;}th,td{padding:8px;border-bottom:1px solid #1e293b;text-align:left;}tr.active{background:#172554;}tr:hover{background:#0f1b33;}svg{width:100%;height:auto;background:#020617;border:1px solid var(--line);border-radius:12px;} .preview3d{width:100%;height:320px;background:#020617;border:1px solid var(--line);border-radius:12px;overflow:hidden;position:relative;} .preview3d canvas{display:block;width:100%;height:100%;} .preview3d.empty{display:flex;align-items:center;justify-content:center;padding:16px;text-align:center;color:var(--muted);}\n"
".hero{display:flex;justify-content:space-between;gap:16px;align-items:flex-start;flex-wrap:wrap;margin-bottom:16px;}.hero .title{flex:1 1 420px;}.hero .actions{display:flex;gap:8px;flex-wrap:wrap;}.grid{display:grid;grid-template-columns:1.08fr .92fr;gap:16px;align-items:start;}.col{display:grid;gap:16px;}.card{background:rgba(17,24,39,.96);border:1px solid rgba(51,65,85,.9);border-radius:16px;padding:16px;box-shadow:0 12px 30px rgba(0,0,0,.18);} .row{display:grid;grid-template-columns:repeat(4,1fr);gap:10px;} .row2{display:grid;grid-template-columns:repeat(2,1fr);gap:10px;} .toolbar{display:flex;flex-wrap:wrap;gap:8px;margin-bottom:12px;} .stack{display:grid;gap:10px;} .status{display:flex;gap:16px;flex-wrap:wrap;font-size:14px;} .pill{display:inline-block;padding:4px 10px;border-radius:999px;background:#0b1220;border:1px solid var(--line);} .ok{color:#86efac;} .warn-txt{color:#fcd34d;} .frame-list{max-height:360px;overflow:auto;border:1px solid var(--line);border-radius:12px;} .mini{font-size:12px;} .split{display:grid;grid-template-columns:1fr 1fr;gap:12px;} .range-row{display:grid;grid-template-columns:70px 1fr 72px;gap:8px;align-items:center;} .json-tools{display:flex;gap:8px;flex-wrap:wrap;margin-bottom:10px;} .drag-tip{margin-top:8px;} .drag-handle{cursor:grab;touch-action:none;} .drag-handle.dragging{cursor:grabbing;} .drag-line{cursor:ew-resize;} .guide{display:grid;grid-template-columns:repeat(3,1fr);gap:10px;} .guide-item{padding:12px;border:1px solid var(--line);border-radius:12px;background:rgba(2,6,23,.55);} .guide-item strong{display:block;margin-bottom:4px;} .quick-grid{display:grid;grid-template-columns:repeat(3,1fr);gap:10px;} .quick-btn{width:100%;text-align:left;padding:12px 14px;border-radius:12px;background:#13213d;border:1px solid #28406f;} .quick-btn strong{display:block;margin-bottom:3px;font-size:14px;} .quick-btn span{display:block;font-size:12px;color:var(--muted);} .section-note{margin-top:10px;font-size:12px;color:var(--muted);} .compact{margin-bottom:0;} .template-side-note{margin-top:10px;padding:10px 12px;border-radius:12px;background:#0b1220;border:1px solid var(--line);font-size:12px;color:var(--muted);} details.card summary{cursor:pointer;list-style:none;font-weight:700;} details.card summary::-webkit-details-marker{display:none;} details.card[open] summary{margin-bottom:12px;} .field-hidden{display:none;} @media (max-width:1100px){.grid{grid-template-columns:1fr;}.row,.row2,.split,.guide,.quick-grid{grid-template-columns:1fr;}}\n"
"</style>\n"
"</head>\n"
"<body>\n"
"<main>\n"
"  <section class='hero'>\n"
"    <div class='title'>\n"
"      <h1>Motutu 关键帧编排器</h1>\n"
"      <div class='muted'>设备内置 H5 页面，支持关键帧编辑、机械狗模型预览、文本/模板生成，以及 Rerobot 适配导入导出。</div>\n"
"    </div>\n"
"    <div class='actions'>\n"
"      <button onclick='refreshDeviceMeta()'>刷新设备信息</button>\n"
"      <button class='secondary' onclick='loadCurrentPoseFrame()'>导入当前姿态</button>\n"
"      <button class='secondary' onclick='showControlPageHint()'>屏幕显示地址</button>\n"
"    </div>\n"
"  </section>\n"
"  <section class='card'>\n"
"    <div class='guide'>\n"
"      <div class='guide-item'><strong>1. 先跑常用动作</strong><span class='mini muted'>站立、校正、前进、转向都在一键动作里，先确认机械状态。</span></div>\n"
"      <div class='guide-item'><strong>2. 再调模板参数</strong><span class='mini muted'>要改步数、摆幅、速度时，用模板运行区；选完参数可直接运行。</span></div>\n"
"      <div class='guide-item'><strong>3. 最后再做高级编辑</strong><span class='mini muted'>关键帧和 JSON 留给需要精调或接云端编排时再用。</span></div>\n"
"    </div>\n"
"  </section>\n"
"  <div class='grid'>\n"
"    <div class='col'>\n"
"      <section class='card'>\n"
"        <h2>设备状态</h2>\n"
"        <div class='status'>\n"
"          <span class='pill'>Ready: <strong id='readyText'>-</strong></span>\n"
"          <span class='pill'>IP: <strong id='ipText'>-</strong></span>\n"
"          <span class='pill'>URL: <strong id='urlText'>-</strong></span>\n"
"          <span class='pill'>格式: <strong id='formatText'>motutu / rerobot</strong></span>\n"
"        </div>\n"
"        <div class='mini muted' id='jointMetaText' style='margin-top:10px;'></div>\n"
"      </section>\n"
"      <section class='card'>\n"
"        <h2>常用动作</h2>\n"
"        <div class='quick-grid'>\n"
"          <button class='quick-btn' onclick=\"quickRun('stand','normal',1,18,0)\"><strong>站立复位</strong><span>直接回默认站立姿态</span></button>\n"
"          <button class='quick-btn' onclick=\"quickRun('init','normal',1,18,0)\"><strong>校正位置</strong><span>回装配伸直位，便于对位</span></button>\n"
"          <button class='quick-btn' onclick=\"quickRun('down','normal',1,18,0)\"><strong>趴下</strong><span>快速测试低姿态动作</span></button>\n"
"          <button class='quick-btn' onclick=\"quickRun('walk','normal',5,18,0)\"><strong>前进 5 步</strong><span>完整检查前进行走和回站立</span></button>\n"
"          <button class='quick-btn' onclick=\"quickRun('back','normal',5,18,0)\"><strong>后退 5 步</strong><span>完整检查后退步态和回站立</span></button>\n"
"          <button class='quick-btn' onclick=\"quickRun('left','normal',2,18,80)\"><strong>左转</strong><span>延长转向节奏，观察落脚后回站立</span></button>\n"
"          <button class='quick-btn' onclick=\"quickRun('right','normal',2,18,80)\"><strong>右转</strong><span>延长转向节奏，观察落脚后回站立</span></button>\n"
"          <button class='quick-btn' onclick=\"quickRun('wave_left','normal',1,18,0)\"><strong>左招手</strong><span>测试左前腿抬起动作</span></button>\n"
"          <button class='quick-btn' onclick=\"quickRun('wave_right','normal',1,18,0)\"><strong>右招手</strong><span>测试右前腿抬起动作</span></button>\n"
"        </div>\n"
"        <div class='section-note'>这里是现场联调最常用的入口；只有需要更细的速度、步数和摆幅控制时，再用下面的模板运行。</div>\n"
"      </section>\n"
"      <section class='card'>\n"
"        <h2>模板运行</h2>\n"
"        <div class='row2'>\n"
"          <div><label>模板</label><select id='genKind'><option value='stand'>站立复位</option><option value='init'>校正位置</option><option value='down'>趴下</option><option value='nod'>点头</option><option value='swing'>左右摆</option><option value='flip'>翻跟斗</option><option value='wave_left'>左招手</option><option value='wave_right'>右招手</option><option value='shake_left'>左握手</option><option value='shake_right'>右握手</option><option value='spin_left'>原地左旋</option><option value='spin_right'>原地右旋</option><option value='serve_left'>左前发球</option><option value='serve_right'>右前发球</option><option value='walk'>前进</option><option value='back'>后退</option><option value='left'>左转</option><option value='right'>右转</option></select></div>\n"
"          <div><label>速度</label><select id='genSpeed'><option value='slow'>slow</option><option value='normal' selected>normal</option><option value='fast'>fast</option></select></div>\n"
"        </div>\n"
"        <div class='row' style='margin-top:10px;'>\n"
"          <div id='genStepsWrap'><label>步数 / 循环</label><input id='genSteps' type='number' min='1' max='32' value='5'></div>\n"
"          <div id='genAmpWrap'><label>摆幅(逻辑角度)</label><input id='genAmp' type='number' min='6' max='36' value='18'></div>\n"
"          <div id='genRecoverWrap'><label>回摆角</label><input id='genRecover' type='number' min='2' max='16' value='6'></div>\n"
"          <div id='genPauseWrap'><label>额外停顿(ms)</label><input id='genPause' type='number' min='0' max='1000' step='20' value='0'></div>\n"
"        </div>\n"
"        <div class='template-side-note' id='templateHint'>当前模板会先生成关键帧，再可直接整段发到设备。</div>\n"
"        <div style='margin-top:10px;'><label>文本描述（可选）</label><textarea id='promptText' style='min-height:92px;' placeholder='例如: 生成一个前进3步、慢速、小摆幅的动作草稿；或：点头两次后回站立'></textarea></div>\n"
"        <div class='toolbar' style='margin-top:12px;'>\n"
"          <button class='primary' id='runTemplateBtn' onclick='runTemplateNow()'>运行模板</button>\n"
"          <button onclick='generateFromControls()'>只生成关键帧</button>\n"
"          <button class='secondary' onclick='runPromptNow()'>按文本运行</button>\n"
"          <button class='ghost' onclick='generateFromPrompt()'>按文本生成</button>\n"
"          <button class='ghost' onclick='appendGenerated()'>追加到现有序列</button>\n"
"        </div>\n"
"      </section>\n"
"      <section class='card'>\n"
"        <h2>运行与结果</h2>\n"
"        <div class='toolbar'>\n"
"          <button onclick='sendSequence()'>发送到设备</button>\n"
"          <button class='ghost' onclick='playPreview()'>预览</button>\n"
"          <button class='ghost' onclick='stopPreview()'>停止预览</button>\n"
"          <button class='secondary' onclick='queryStatus()'>查询状态</button>\n"
"        </div>\n"
"        <div class='row2' style='margin:12px 0 10px;'>\n"
"          <div><label>执行范围</label><select id='execScopeTop' onchange='syncExecutionScopes(this.value)'><option value='current'>当前帧</option><option value='all' selected>全部帧</option></select></div>\n"
"          <div class='mini muted' style='align-self:end;'>调单个姿态时选“当前帧”，整段联调时选“全部帧”。</div>\n"
"        </div>\n"
"        <pre id='outTop'>页面已加载，等待操作。</pre>\n"
"      </section>\n"
"    </div>\n"
"    <div class='col'>\n"
"      <section class='card'>\n"
"        <h2>机械狗模型预览</h2>\n"
"        <div id='dog3dCanvas' class='preview3d'></div>\n"
"        <div class='mini muted' id='dog3dStatus' style='margin-top:8px;'>3D 预览初始化中...</div>\n"
"        <div class='mini muted' style='margin-top:8px;'>先看上方 3D 大姿态，再用下面 2D 拖拽修正单腿，会比直接盯数字更容易。</div>\n"
"        <div style='height:10px;'></div>\n"
"        <svg id='dogSvg' viewBox='0 0 420 260' aria-label='motutu-model'>\n"
"          <rect x='130' y='82' width='160' height='92' rx='20' fill='#1e293b' stroke='#64748b' stroke-width='2'></rect>\n"
"          <circle cx='305' cy='110' r='22' fill='#1e293b' stroke='#64748b' stroke-width='2'></circle>\n"
"          <line id='lfLeg' class='drag-line' data-joint='lf' x1='255' y1='106' x2='240' y2='140' stroke='#38bdf8' stroke-width='8' stroke-linecap='round'></line>\n"
"          <line id='lrLeg' class='drag-line' data-joint='lr' x1='165' y1='106' x2='150' y2='140' stroke='#22c55e' stroke-width='8' stroke-linecap='round'></line>\n"
"          <line id='rfLeg' class='drag-line' data-joint='rf' x1='255' y1='166' x2='270' y2='206' stroke='#f472b6' stroke-width='8' stroke-linecap='round'></line>\n"
"          <line id='rrLeg' class='drag-line' data-joint='rr' x1='165' y1='166' x2='180' y2='206' stroke='#f59e0b' stroke-width='8' stroke-linecap='round'></line>\n"
"          <circle id='lfHandle' class='drag-handle' data-joint='lf' cx='240' cy='140' r='10' fill='#38bdf8' stroke='#e0f2fe' stroke-width='2'></circle>\n"
"          <circle id='lrHandle' class='drag-handle' data-joint='lr' cx='150' cy='140' r='10' fill='#22c55e' stroke='#dcfce7' stroke-width='2'></circle>\n"
"          <circle id='rfHandle' class='drag-handle' data-joint='rf' cx='270' cy='206' r='10' fill='#f472b6' stroke='#fce7f3' stroke-width='2'></circle>\n"
"          <circle id='rrHandle' class='drag-handle' data-joint='rr' cx='180' cy='206' r='10' fill='#f59e0b' stroke='#fef3c7' stroke-width='2'></circle>\n"
"          <text x='242' y='132' fill='#38bdf8' font-size='14'>LF</text>\n"
"          <text x='152' y='132' fill='#22c55e' font-size='14'>LR</text>\n"
"          <text x='272' y='224' fill='#f472b6' font-size='14'>RF</text>\n"
"          <text x='182' y='224' fill='#f59e0b' font-size='14'>RR</text>\n"
"        </svg>\n"
"        <div class='mini muted drag-tip'>可直接拖动四个圆点，生成当前帧姿态。</div>\n"
"        <div class='mini muted' id='modelText' style='margin-top:10px;'></div>\n"
"      </section>\n"
"      <section class='card'>\n"
"        <h2>当前帧编辑</h2>\n"
"        <div class='row2'>\n"
"          <div><label>帧名称</label><input id='frameName' placeholder='例如: step-1'></div>\n"
"          <div><label>顶层结束停顿(ms)</label><input id='topDelay' type='number' min='0' max='10000' step='20' value='0'></div>\n"
"        </div>\n"
"        <div class='stack' style='margin-top:12px;'>\n"
"          <div class='range-row'><strong>LF</strong><input id='lfRange' type='range' min='0' max='270' value='90'><input id='lfNumber' type='number' min='0' max='270' value='90'></div>\n"
"          <div class='range-row'><strong>RF</strong><input id='rfRange' type='range' min='0' max='270' value='90'><input id='rfNumber' type='number' min='0' max='270' value='90'></div>\n"
"          <div class='range-row'><strong>LR</strong><input id='lrRange' type='range' min='0' max='270' value='110'><input id='lrNumber' type='number' min='0' max='270' value='110'></div>\n"
"          <div class='range-row'><strong>RR</strong><input id='rrRange' type='range' min='0' max='270' value='110'><input id='rrNumber' type='number' min='0' max='270' value='110'></div>\n"
"        </div>\n"
"        <div class='row2' style='margin-top:12px;'>\n"
"          <div><label>过渡时长 v (ms)</label><input id='moveMs' type='number' min='20' max='5000' step='20' value='300'></div>\n"
"          <div><label>停顿 d (ms)</label><input id='pauseMs' type='number' min='0' max='10000' step='20' value='0'></div>\n"
"        </div>\n"
"        <div class='mini muted' id='angleRangeTip' style='margin-top:8px;'>角度编辑允许 0-270°；设备建议安全范围读取中...</div>\n"
"      </section>\n"
"      <section class='card'>\n"
"        <h2>关键帧列表</h2>\n"
"        <div class='toolbar'>\n"
"          <button onclick='addFrame()'>新增帧</button>\n"
"          <button class='secondary' onclick='cloneFrame()'>复制当前帧</button>\n"
"          <button class='secondary' onclick='moveFrame(-1)'>上移</button>\n"
"          <button class='secondary' onclick='moveFrame(1)'>下移</button>\n"
"          <button class='warn' onclick='deleteFrame()'>删除当前帧</button>\n"
"        </div>\n"
"        <div class='frame-list'>\n"
"          <table>\n"
"            <thead><tr><th>#</th><th>名称</th><th>LF</th><th>RF</th><th>LR</th><th>RR</th><th>过渡</th><th>停顿</th></tr></thead>\n"
"            <tbody id='frameTable'></tbody>\n"
"          </table>\n"
"        </div>\n"
"        <div class='section-note'>只有需要精调单帧、重排顺序时再使用这里；大部分现场调试用左侧的常用动作和模板运行就够了。</div>\n"
"      </section>\n"
"      <details class='card'>\n"
"        <summary>高级：JSON / Rerobot 对接</summary>\n"
"        <div class='json-tools'>\n"
"          <button onclick='syncJsonText()'>同步 JSON</button>\n"
"          <button class='secondary' onclick='exportMotutuJson()'>导出 Motutu JSON</button>\n"
"          <button class='secondary' onclick='exportRerobotJson()'>导出 Rerobot 适配 JSON</button>\n"
"          <button class='ghost' onclick='applyJsonEditor()'>应用文本到关键帧</button>\n"
"          <button class='ghost' onclick='document.getElementById(\"importFile\").click()'>导入文件</button>\n"
"          <button class='ghost' onclick='clearToHome()'>清空为站立</button>\n"
"          <input id='importFile' type='file' accept='.json,application/json' style='display:none'>\n"
"        </div>\n"
"        <textarea id='jsonText'></textarea>\n"
"        <div class='mini muted' style='margin-top:8px;'>可直接改这里的 JSON；改完点“应用文本到关键帧”，或按 `Ctrl+Enter`，关键帧列表会立刻同步。设备支持角度帧 `s:{lf,rf,lr,rr}`，也支持直接下发脉宽帧 `p:{lf,rf,lr,rr}`。</div>\n"
"      </details>\n"
"    </div>\n"
"  </div>\n"
"</main>\n"
"<script>\n"
"const JOINT_KEYS=['lf','rf','lr','rr'];\n"
"const MODEL_HIPS={lf:[255,106],lr:[165,106],rf:[255,166],rr:[165,166]};\n"
"const MODEL_FEET_Y={lf:140,lr:140,rf:206,rr:206};\n"
"const MODEL_X_SCALE=1.3;\n"
"const MODEL_VIEW_SIGN=-1;\n"
"const TEMPLATE_META={stand:{label:'站立复位',desc:'直接回默认站立姿态，适合作为动作结束回位。',steps:false,amp:false,recover:false},init:{label:'校正位置',desc:'回装配伸直位，便于结构对位。',steps:false,amp:false,recover:false},down:{label:'趴下',desc:'快速测试低姿态动作。',steps:false,amp:true,recover:false},nod:{label:'点头',desc:'用于验证前腿小幅往复动作。',steps:false,amp:false,recover:false},swing:{label:'左右摆',desc:'左右摆动身体，适合看整体协调。',steps:false,amp:true,recover:false},flip:{label:'翻跟斗',desc:'完整的大动作模板，建议先单独预览。',steps:false,amp:false,recover:false},wave_left:{label:'左招手',desc:'左前腿抬起并挥动。',steps:false,amp:false,recover:false},wave_right:{label:'右招手',desc:'右前腿抬起并挥动。',steps:false,amp:false,recover:false},shake_left:{label:'左握手',desc:'左前腿抬起做握手动作。',steps:false,amp:false,recover:false},shake_right:{label:'右握手',desc:'右前腿抬起做握手动作。',steps:false,amp:false,recover:false},spin_left:{label:'原地左旋',desc:'原地连续左转，循环数越大转得越多。',steps:true,amp:true,recover:true},spin_right:{label:'原地右旋',desc:'原地连续右转，循环数越大转得越多。',steps:true,amp:true,recover:true},serve_left:{label:'左前发球',desc:'左前腿前送动作。',steps:false,amp:false,recover:false},serve_right:{label:'右前发球',desc:'右前腿前送动作。',steps:false,amp:false,recover:false},walk:{label:'前进',desc:'最常用步态，建议从 1 步开始调。',steps:true,amp:true,recover:true},back:{label:'后退',desc:'反向步态，适合检查后腿配合。',steps:true,amp:true,recover:true},left:{label:'左转',desc:'左右腿摆幅不同的转向模板。',steps:true,amp:true,recover:true},right:{label:'右转',desc:'左右腿摆幅不同的转向模板。',steps:true,amp:true,recover:true}};\n"
"const state={meta:null,status:null,frames:[],selected:0,generated:null,playTimer:null,dragKey:null,three:null};\n"
"const NATIVE_RUN_TEMPLATES=new Set(['stand','init']);\n"
"function qs(id){return document.getElementById(id);}function qsa(sel){return Array.from(document.querySelectorAll(sel));}function clamp(v,min,max){v=Number(v);if(Number.isNaN(v))v=min;return Math.max(min,Math.min(max,v));}function sleep(ms){return new Promise(resolve=>setTimeout(resolve,ms));}function deepCopy(v){return JSON.parse(JSON.stringify(v));}function setOut(v){const text=typeof v==='string'?v:JSON.stringify(v,null,2);['out','outTop'].forEach(id=>{const el=qs(id);if(el)el.textContent=text;});}const PRESET_PULSES={init:{lf:1500,rf:1500,lr:1315,rr:1315},stand:{lf:1950,rf:1050,lr:950,rr:1750}};function getJointMeta(key){const arr=state.meta&&state.meta.joints?state.meta.joints:[];const raw=arr.find(j=>j.key===key);if(raw){return Object.assign({},raw,{pulse_center_us:Number(raw.pulse_center_us??raw.center_us??(key==='lf'||key==='rf'?1500:1315)),pulse_min_us:Number(raw.pulse_min_us??raw.min_us??500),pulse_max_us:Number(raw.pulse_max_us??raw.max_us??2500)});}return {key,dir:key==='rf'||key==='rr'?-1:1,center_abs_deg:key==='lf'||key==='rf'?90:110,pulse_center_us:key==='lf'||key==='rf'?1500:1315,pulse_min_us:500,pulse_max_us:2500,min_abs_deg:0,max_abs_deg:270,min_logical_deg:key==='lf'?-180:(key==='rf'?-100:(key==='lr'?-90:-180)),max_logical_deg:key==='lf'?120:(key==='rf'?100:(key==='lr'?180:100))};}function presetPulseForJoint(kind,key){const preset=PRESET_PULSES[kind]||PRESET_PULSES.stand;return Number(preset[key]);}function clampPulseForJoint(key,pulse){const j=getJointMeta(key);return Math.round(clamp(pulse,j.pulse_min_us??500,j.pulse_max_us??2500));}function pulseToLogical(pulse,key){const j=getJointMeta(key);let value=clamp(pulse,j.pulse_min_us??500,j.pulse_max_us??2500);const center=Number(j.pulse_center_us??(key==='lf'||key==='rf'?1500:1315));const minPulse=Number(j.pulse_min_us??500);const maxPulse=Number(j.pulse_max_us??2500);const minLogical=Number(j.min_logical_deg??-180);const maxLogical=Number(j.max_logical_deg??180);const dir=Number(j.dir??1);if(value===center)return 0;if(dir>=0){if(value>center){const span=maxPulse-center;return span>0?((value-center)*maxLogical)/span:0;}const span=center-minPulse;return span>0?-(((center-value)*(-minLogical))/span):0;}if(value<center){const span=center-minPulse;return span>0?(((center-value)*maxLogical)/span):0;}const span=maxPulse-center;return span>0?-(((value-center)*(-minLogical))/span):0;}function logicalToPulse(logical,key){const j=getJointMeta(key);const center=Number(j.pulse_center_us??(key==='lf'||key==='rf'?1500:1315));const minPulse=Number(j.pulse_min_us??500);const maxPulse=Number(j.pulse_max_us??2500);const minLogical=Number(j.min_logical_deg??-180);const maxLogical=Number(j.max_logical_deg??180);const dir=Number(j.dir??1);const value=Number(logical);let pulse=center;if(dir>=0){if(value>=0){const span=maxPulse-center;pulse=center+(maxLogical!==0?(value*span)/maxLogical:0);}else{const span=center-minPulse;pulse=center-((-minLogical)!==0?((-value)*span)/(-minLogical):0);}}else if(value>=0){const span=center-minPulse;pulse=center-(maxLogical!==0?(value*span)/maxLogical:0);}else{const span=maxPulse-center;pulse=center+((-minLogical)!==0?((-value)*span)/(-minLogical):0);}return clampPulseForJoint(key,pulse);}function pulseToAbs(pulse,key){return logicalToAbs(pulseToLogical(pulse,key),key);}function presetLogicalForJoint(kind,key){return pulseToLogical(presetPulseForJoint(kind,key),key);}function presetPulseMap(kind){return JOINT_KEYS.reduce((acc,key)=>{acc[key]=presetPulseForJoint(kind,key);return acc;},{});}function pulseMapToAbs(pulseMap){return JOINT_KEYS.reduce((acc,key)=>{acc[key]=pulseToAbs(Number(pulseMap[key]),key);return acc;},{});}function standLogicalForJoint(key){return presetLogicalForJoint('stand',key);}function standTravelForJoint(key){return Math.max(8,Math.round(Math.abs(standLogicalForJoint(key))));}function towardCalibrateOffset(key,ratio,minDeg){const base=standLogicalForJoint(key);const amount=Math.max(minDeg??4,Math.round(standTravelForJoint(key)*ratio));return base>=0?-amount:amount;}function awayFromCalibrateOffset(key,ratio,minDeg){return -towardCalibrateOffset(key,ratio,minDeg);}function towardCalibratePulse(key,ratio,minUs){const stand=presetPulseForJoint('stand',key);const init=presetPulseForJoint('init',key);const amount=Math.max(minUs??24,Math.round(Math.abs(init-stand)*ratio));return clampPulseForJoint(key,stand+Math.sign(init-stand)*amount);}function awayFromCalibratePulse(key,ratio,minUs){const stand=presetPulseForJoint('stand',key);const init=presetPulseForJoint('init',key);const amount=Math.max(minUs??24,Math.round(Math.abs(init-stand)*ratio));return clampPulseForJoint(key,stand-Math.sign(init-stand)*amount);}function buildPulseFrame(name,pulseMap,v,d){const p={};const s={};JOINT_KEYS.forEach(key=>{const pulse=clampPulseForJoint(key,pulseMap[key]??presetPulseForJoint('stand',key));p[key]=pulse;s[key]=pulseToAbs(pulse,key);});return {name,p:p,s:s,v:clamp(v,20,5000),d:clamp(d||0,0,10000)};}function pulseDeltaMax(a,b){let delta=0;JOINT_KEYS.forEach(key=>{delta=Math.max(delta,Math.abs(Number((a&&a[key])??presetPulseForJoint('stand',key))-Number((b&&b[key])??presetPulseForJoint('stand',key))));});return delta;}function easeInOut(t){const x=clamp(t,0,1);return 0.5-(Math.cos(Math.PI*x)/2);}function smoothGeneratedFrames(kind,frames){if(!Array.isArray(frames)||!frames.length||kind==='stand'||kind==='init'){return frames||[];}let prev=presetPulseMap('stand');const out=[];frames.forEach((frame,idx)=>{const target=(frame&&frame.p)?frame.p:presetPulseMap('stand');const name=frame&&frame.name?frame.name:`frame-${idx+1}`;const move=clamp(frame&&frame.v||300,20,5000);const hold=clamp(frame&&frame.d||0,0,10000);const delta=pulseDeltaMax(prev,target);let parts=1;if(delta>=220)parts=4;else if(delta>=140)parts=3;else if(delta>=70)parts=2;const piece=Math.max(20,Math.floor(move/parts));let used=0;for(let i=1;i<=parts;i++){const isLast=i===parts;const interp=JOINT_KEYS.reduce((acc,key)=>{acc[key]=clampPulseForJoint(key,Math.round(Number(prev[key])+((Number(target[key])-Number(prev[key]))*easeInOut(i/parts))));return acc;},{});const stepMove=isLast?Math.max(20,move-used):piece;used+=stepMove;out.push(buildPulseFrame(isLast?name:`${name}-ease-${i}`,interp,stepMove,isLast?hold:0));}prev=Object.assign({},target);});return out;}function basePose(kind){const baseKind=(kind==='calibrate'||kind==='init')?'init':'stand';return pulseMapToAbs(presetPulseMap(baseKind));}function defaultCalibratePose(){return basePose('init');}function defaultStandPose(){return basePose('stand');}function defaultHomePose(){return defaultStandPose();}function defaultFrame(name){return {name:name||('frame-'+(state.frames.length+1)),s:defaultStandPose(),v:300,d:0};}\n"
"function absToLogical(abs,key){const j=getJointMeta(key);return j.dir*(Number(abs)-Number(j.center_abs_deg??90));}function logicalToAbs(logical,key){const j=getJointMeta(key);return clamp(Number(j.center_abs_deg??90)+j.dir*Number(logical),Number(j.min_abs_deg??0),Number(j.max_abs_deg??270));}function logicalToView(logical){return Number(logical)*MODEL_VIEW_SIGN;}function viewToLogical(viewLogical){return Number(viewLogical)*MODEL_VIEW_SIGN;}function currentFrame(){if(!state.frames.length){state.frames=[defaultFrame('frame-1')];state.selected=0;}return state.frames[state.selected];}\n"
"function buildSequenceObject(frames){return {a:(frames||state.frames).map((f,idx)=>{const item={n:f.name||('frame-'+(idx+1)),v:clamp(f.v||300,20,5000),d:clamp(f.d||0,0,10000)};if(f.p){item.p={lf:clampPulseForJoint('lf',f.p.lf),rf:clampPulseForJoint('rf',f.p.rf),lr:clampPulseForJoint('lr',f.p.lr),rr:clampPulseForJoint('rr',f.p.rr)};}else{item.s={lf:clamp(f.s.lf,0,270),rf:clamp(f.s.rf,0,270),lr:clamp(f.s.lr,0,270),rr:clamp(f.s.rr,0,270)};}return item;}),d:clamp(qs('topDelay').value||0,0,10000)};}\n"
"function getTemplateMeta(kind){return TEMPLATE_META[kind]||{label:kind,desc:'当前模板会先生成关键帧，再可直接整段发到设备。',steps:true,amp:true,recover:false};}\n"
"function setFieldVisible(id,visible){const el=qs(id);if(!el)return;el.classList.toggle('field-hidden',!visible);}\n"
"function refreshTemplateForm(){const kind=qs('genKind').value;const meta=getTemplateMeta(kind);setFieldVisible('genStepsWrap',!!meta.steps);setFieldVisible('genAmpWrap',meta.amp!==false);setFieldVisible('genRecoverWrap',!!meta.recover);setFieldVisible('genPauseWrap',true);const hint=qs('templateHint');if(hint){hint.textContent=meta.desc+(meta.steps?' 可通过“步数 / 循环”控制重复次数。':' 该模板不需要额外步数设置。');}const runBtn=qs('runTemplateBtn');if(runBtn){runBtn.textContent=`运行${meta.label}`;}}\n"
"function shouldRunViaNative(template){return NATIVE_RUN_TEMPLATES.has(String(template||'').trim().toLowerCase());}\n"
"async function runNamedAction(template,steps,speed){const key=String(template||'').trim().toLowerCase();const payload={action:'dog_pose_preset',params:{name:key}};if(steps!=null&&payload.params){payload.params.steps=steps;}if(speed&&payload.params){payload.params.speed=speed;}try{const res=await fetch('/api/command',{method:'POST',headers:{'Content-Type':'application/json'},body:JSON.stringify(payload)});const data=await res.json();setOut(typeof data==='object'&&data?Object.assign({template:key},data):data);await refreshDeviceMeta();}catch(err){setOut('执行动作失败: '+err);}}\n"
"async function quickRun(kind,speed,steps,amp,pause){qs('genKind').value=kind;qs('genSpeed').value=speed||'normal';qs('genSteps').value=steps||1;qs('genAmp').value=amp||18;qs('genPause').value=pause||0;refreshTemplateForm();generateFromControls();if(shouldRunViaNative(kind)){await runNamedAction(kind,steps||1,speed||'normal');return;}await sendSequence('all');}\n"
"function syncJsonText(){qs('jsonText').value=JSON.stringify(buildSequenceObject(),null,2);}function selectFrame(index){state.selected=clamp(index,0,state.frames.length-1);renderAll();}\n"
"function renderFrameTable(){const tb=qs('frameTable');tb.innerHTML='';state.frames.forEach((f,idx)=>{const tr=document.createElement('tr');if(idx===state.selected)tr.className='active';tr.onclick=()=>selectFrame(idx);tr.innerHTML=`<td>${idx+1}</td><td>${f.name||''}</td><td>${f.s.lf}</td><td>${f.s.rf}</td><td>${f.s.lr}</td><td>${f.s.rr}</td><td>${f.v}</td><td>${f.d||0}</td>`;tb.appendChild(tr);});}\n"
"function setSliderPair(key,value){const range=qs(key+'Range');const num=qs(key+'Number');if(range)range.value=value;if(num)num.value=value;}\n"
"function renderInspector(){const f=currentFrame();qs('frameName').value=f.name||'';qs('moveMs').value=f.v||300;qs('pauseMs').value=f.d||0;JOINT_KEYS.forEach(k=>setSliderPair(k,f.s[k]));}\n"
"function updateFrameFromInputs(){const f=currentFrame();f.name=qs('frameName').value||('frame-'+(state.selected+1));f.v=clamp(qs('moveMs').value,20,5000);f.d=clamp(qs('pauseMs').value,0,10000);delete f.p;JOINT_KEYS.forEach(k=>{f.s[k]=clamp(qs(k+'Number').value,0,270);});renderAll();}\n"
"function applySliderMeta(){const tips=[];JOINT_KEYS.forEach(k=>{const meta=getJointMeta(k);const safeMin=meta.min_abs_deg??0;const safeMax=meta.max_abs_deg??270;const hint=`设备建议安全范围 ${safeMin}-${safeMax}°`;const range=qs(k+'Range');const num=qs(k+'Number');range.min=0;range.max=270;num.min=0;num.max=270;range.title=hint;num.title=hint;tips.push(`${k.toUpperCase()} ${safeMin}-${safeMax}°`);});const tip=qs('angleRangeTip');if(tip){tip.textContent=`角度编辑允许 0-270°；当前设备建议安全范围：${tips.join(' / ')}`;}}\n"
"function renderDogModel(){const f=currentFrame();JOINT_KEYS.forEach(k=>{const line=qs(k+'Leg');const handle=qs(k+'Handle');const hip=MODEL_HIPS[k];const footY=MODEL_FEET_Y[k];const logical=absToLogical(f.s[k],k);const footX=hip[0]+logicalToView(logical)*MODEL_X_SCALE;line.setAttribute('x1',hip[0]);line.setAttribute('y1',hip[1]);line.setAttribute('x2',footX);line.setAttribute('y2',footY);handle.setAttribute('cx',footX);handle.setAttribute('cy',footY);handle.classList.toggle('dragging',state.dragKey===k);});qs('modelText').textContent=`当前帧 ${state.selected+1}/${state.frames.length} | 逻辑角: LF ${absToLogical(f.s.lf,'lf')} / RF ${absToLogical(f.s.rf,'rf')} / LR ${absToLogical(f.s.lr,'lr')} / RR ${absToLogical(f.s.rr,'rr')}`;}\n"
"function initThreePreview(){const host=qs('dog3dCanvas');const status=qs('dog3dStatus');if(!host||state.three){return;}if(!(window.THREE&&window.THREE.WebGLRenderer)){host.classList.add('empty');host.textContent='当前浏览器没有加载到 three.js，已回退到下方 2D 编辑器。';if(status)status.textContent='3D 预览未启用：three.js CDN 不可用';return;}const THREE=window.THREE;const scene=new THREE.Scene();scene.background=new THREE.Color(0x020617);const camera=new THREE.PerspectiveCamera(34,Math.max(1,host.clientWidth)/Math.max(1,host.clientHeight),0.1,100);camera.position.set(0.2,2.4,5.8);const renderer=new THREE.WebGLRenderer({antialias:true,alpha:true});renderer.setPixelRatio(Math.min(window.devicePixelRatio||1,2));renderer.setSize(Math.max(1,host.clientWidth),Math.max(1,host.clientHeight));host.innerHTML='';host.appendChild(renderer.domElement);const controls=THREE.OrbitControls?new THREE.OrbitControls(camera,renderer.domElement):null;if(controls){controls.enableDamping=true;controls.target.set(0.35,0.55,0);controls.update();}camera.lookAt(0.35,0.55,0);scene.add(new THREE.AmbientLight(0xffffff,1.35));const keyLight=new THREE.DirectionalLight(0xffffff,1.8);keyLight.position.set(3.2,5.5,4.2);scene.add(keyLight);const rimLight=new THREE.DirectionalLight(0x60a5fa,0.9);rimLight.position.set(-3.2,2.4,-4.4);scene.add(rimLight);const floor=new THREE.Mesh(new THREE.CircleGeometry(3.4,48),new THREE.MeshStandardMaterial({color:0x0f172a,metalness:0.05,roughness:0.95}));floor.rotation.x=-Math.PI/2;floor.position.y=-0.66;scene.add(floor);const rig=new THREE.Group();rig.position.x=-0.42;scene.add(rig);const bodyPivot=new THREE.Group();rig.add(bodyPivot);const body=new THREE.Mesh(new THREE.BoxGeometry(2.15,0.8,1.1),new THREE.MeshStandardMaterial({color:0x1e293b,metalness:0.18,roughness:0.72}));body.position.y=0.72;bodyPivot.add(body);const head=new THREE.Mesh(new THREE.SphereGeometry(0.34,28,20),new THREE.MeshStandardMaterial({color:0x334155,metalness:0.12,roughness:0.7}));head.position.set(1.28,0.88,0);bodyPivot.add(head);const nose=new THREE.Mesh(new THREE.BoxGeometry(0.22,0.14,0.18),new THREE.MeshStandardMaterial({color:0x475569}));nose.position.set(1.55,0.78,0);bodyPivot.add(nose);const legs={};function makeLeg(key,x,z,color){const hip=new THREE.Group();hip.position.set(x,0.45,z);bodyPivot.add(hip);const upper=new THREE.Mesh(new THREE.CylinderGeometry(0.06,0.075,1.02,18),new THREE.MeshStandardMaterial({color:color,metalness:0.1,roughness:0.55}));upper.position.y=-0.5;hip.add(upper);const foot=new THREE.Mesh(new THREE.SphereGeometry(0.1,18,14),new THREE.MeshStandardMaterial({color:0xe2e8f0,metalness:0.02,roughness:0.9}));foot.position.y=-1.02;hip.add(foot);legs[key]=hip;}makeLeg('lf',0.62,-0.34,0x38bdf8);makeLeg('rf',0.62,0.34,0xf472b6);makeLeg('lr',-0.54,-0.34,0x22c55e);makeLeg('rr',-0.54,0.34,0xf59e0b);state.three={scene,camera,renderer,controls,bodyPivot,rig,legs,host,lastW:0,lastH:0};if(status)status.textContent='3D 预览已启用：可拖动鼠标旋转视角';const tick=()=>{if(!state.three||state.three.host!==host){return;}const w=Math.max(1,host.clientWidth);const h=Math.max(1,host.clientHeight);if(w!==state.three.lastW||h!==state.three.lastH){state.three.lastW=w;state.three.lastH=h;renderer.setSize(w,h,false);camera.aspect=w/h;camera.updateProjectionMatrix();}if(controls){controls.update();}renderer.render(scene,camera);window.requestAnimationFrame(tick);};window.requestAnimationFrame(()=>{if(controls){controls.update();}renderer.render(scene,camera);tick();});}\n"
"function renderThreeDog(){const t=state.three;if(!t){return;}const f=currentFrame();JOINT_KEYS.forEach(k=>{const logical=clamp(absToLogical(f.s[k],k),-50,50);t.legs[k].rotation.z=(logicalToView(logical)*Math.PI/180)*0.95;});const frontBias=(absToLogical(f.s.lf,'lf')+absToLogical(f.s.rf,'rf'))-(absToLogical(f.s.lr,'lr')+absToLogical(f.s.rr,'rr'));const turnBias=(absToLogical(f.s.rf,'rf')+absToLogical(f.s.rr,'rr'))-(absToLogical(f.s.lf,'lf')+absToLogical(f.s.lr,'lr'));t.bodyPivot.rotation.x=clamp(logicalToView(frontBias)*0.008,-0.18,0.18);t.bodyPivot.rotation.y=clamp(logicalToView(turnBias)*0.012,-0.34,0.34);t.rig.position.y=clamp((Math.max(absToLogical(f.s.lf,'lf'),absToLogical(f.s.rf,'rf'))*0.005),-0.06,0.12);}\n"
"function renderMeta(){const ready=Boolean((state.meta&&state.meta.ready)||(state.status&&state.status.ready));qs('readyText').textContent=ready?'true':'false';qs('ipText').textContent=state.meta&&state.meta.ip?state.meta.ip:'<未连接WiFi>';qs('urlText').textContent=state.meta&&state.meta.url?state.meta.url:'<不可用>';qs('formatText').textContent=state.meta&&state.meta.formats?state.meta.formats.join(' / '):'motutu';const text=(state.meta&&state.meta.joints?state.meta.joints:[]).map(j=>`${j.key}: center ${j.center_abs_deg}, abs ${j.min_abs_deg}-${j.max_abs_deg}, logical ${j.min_logical_deg}..${j.max_logical_deg}, dir=${j.dir}`).join(' ｜ ');const sizeTip=state.meta&&state.meta.sequence_body_max?` ｜ 请求上限 ${state.meta.sequence_body_max} bytes`:'';qs('jointMetaText').textContent=(text||'尚未读取到关节校准信息')+sizeTip;}\n"
"function syncExecutionScopes(value){const normalized=value==='current'?'current':'all';['execScope','execScopeTop'].forEach(id=>{const el=qs(id);if(el&&el.value!==normalized)el.value=normalized;});return normalized;}function getExecutionScope(){const top=qs('execScopeTop');const main=qs('execScope');const value=(top&&top.value)||(main&&main.value)||'all';return syncExecutionScopes(value);}function getExecutionFrames(scope){scope=scope||getExecutionScope();if(scope==='current'){return [deepCopy(currentFrame())];}return state.frames.slice();}function getExecutionScopeLabel(scope){return scope==='current'?'当前帧':'全部帧';}\n"
"function renderAll(){if(!state.frames.length){state.frames=[defaultFrame('frame-1')];state.selected=0;}renderFrameTable();renderInspector();renderDogModel();renderThreeDog();renderMeta();syncJsonText();}\n"
"function addFrame(){const f=deepCopy(currentFrame());f.name='frame-'+(state.frames.length+1);state.frames.splice(state.selected+1,0,f);state.selected+=1;renderAll();}\n"
"function cloneFrame(){const f=deepCopy(currentFrame());f.name=(f.name||'frame')+'-copy';state.frames.splice(state.selected+1,0,f);state.selected+=1;renderAll();}\n"
"function deleteFrame(){if(state.frames.length<=1){state.frames=[defaultFrame('frame-1')];state.selected=0;}else{state.frames.splice(state.selected,1);state.selected=Math.max(0,state.selected-1);}renderAll();}\n"
"function moveFrame(dir){const idx=state.selected;const target=idx+dir;if(target<0||target>=state.frames.length)return;const tmp=state.frames[idx];state.frames[idx]=state.frames[target];state.frames[target]=tmp;state.selected=target;renderAll();}\n"
"function downloadText(name,text){const blob=new Blob([text],{type:'application/json'});const a=document.createElement('a');a.href=URL.createObjectURL(blob);a.download=name;document.body.appendChild(a);a.click();setTimeout(()=>{URL.revokeObjectURL(a.href);a.remove();},0);}\n"
"function exportMotutuJson(){downloadText('motutu-seq.json',JSON.stringify(buildSequenceObject(),null,2));}\n"
"function exportRerobotJson(){const frames=state.frames.map((f,idx)=>({index:idx,name:f.name||('frame-'+(idx+1)),duration_ms:f.v||300,pause_ms:f.d||0,pose:{lf:f.s.lf,rf:f.s.rf,lr:f.s.lr,rr:f.s.rr}}));const obj={platform:'rerobot-adapter',version:1,robot:'motutu1.1',url:state.meta&&state.meta.url?state.meta.url:'',frames};downloadText('rerobot-adapter.json',JSON.stringify(obj,null,2));}\n"
"function normalizePose(src){const stand=defaultStandPose();if(Array.isArray(src)){return {lf:clamp(src[0]??stand.lf,0,270),rf:clamp(src[1]??stand.rf,0,270),lr:clamp(src[2]??stand.lr,0,270),rr:clamp(src[3]??stand.rr,0,270)};}src=src||{};return {lf:clamp(src.lf??src.leftFront??src.LF??stand.lf,0,270),rf:clamp(src.rf??src.rightFront??src.RF??stand.rf,0,270),lr:clamp(src.lr??src.leftRear??src.LR??stand.lr,0,270),rr:clamp(src.rr??src.rightRear??src.RR??stand.rr,0,270)};}\n"
"function normalizePulse(src){if(!src)return null;if(Array.isArray(src)){return {lf:clampPulseForJoint('lf',src[0]??presetPulseForJoint('stand','lf')),rf:clampPulseForJoint('rf',src[1]??presetPulseForJoint('stand','rf')),lr:clampPulseForJoint('lr',src[2]??presetPulseForJoint('stand','lr')),rr:clampPulseForJoint('rr',src[3]??presetPulseForJoint('stand','rr'))};}return {lf:clampPulseForJoint('lf',src.lf??src.leftFront??src.LF??presetPulseForJoint('stand','lf')),rf:clampPulseForJoint('rf',src.rf??src.rightFront??src.RF??presetPulseForJoint('stand','rf')),lr:clampPulseForJoint('lr',src.lr??src.leftRear??src.LR??presetPulseForJoint('stand','lr')),rr:clampPulseForJoint('rr',src.rr??src.rightRear??src.RR??presetPulseForJoint('stand','rr'))};}\n"
"function normalizeFrames(obj){if(obj&&Array.isArray(obj.a)){return obj.a.map((item,idx)=>{const pulse=item.p?normalizePulse(item.p):null;return {name:item.n||('frame-'+(idx+1)),s:pulse?pulseMapToAbs(pulse):normalizePose(item.s),p:pulse||undefined,v:clamp(item.v??item.duration_ms??300,20,5000),d:clamp(item.d??item.pause_ms??0,0,10000)};});}if(obj&&Array.isArray(obj.frames)){return obj.frames.map((item,idx)=>{const pulse=item.p?normalizePulse(item.p):null;return {name:item.name||('frame-'+(idx+1)),s:pulse?pulseMapToAbs(pulse):normalizePose(item.pose||item.s||item.joints||item.angles||item.servos),p:pulse||undefined,v:clamp(item.duration_ms??item.duration??item.v??300,20,5000),d:clamp(item.pause_ms??item.pause??item.d??0,0,10000)};});}throw new Error('不支持的 JSON 结构，期望 motutu a[] 或 rerobot frames[]');}\n"
"function importJsonText(){try{const obj=JSON.parse(qs('jsonText').value);state.frames=normalizeFrames(obj);state.selected=0;qs('topDelay').value=clamp(obj.d||0,0,10000);renderAll();setOut('导入成功');}catch(err){setOut('导入失败: '+err.message);}}function applyJsonEditor(){importJsonText();}\n"
"function clearToHome(){state.frames=[{name:'stand',s:defaultStandPose(),v:280,d:0}];state.selected=0;qs('topDelay').value=0;renderAll();}\n"
"function bindFrameInputs(){['frameName','moveMs','pauseMs','topDelay'].forEach(id=>qs(id).addEventListener('input',updateFrameFromInputs));JOINT_KEYS.forEach(k=>{qs(k+'Range').addEventListener('input',e=>{qs(k+'Number').value=e.target.value;updateFrameFromInputs();});qs(k+'Number').addEventListener('input',e=>{qs(k+'Range').value=e.target.value;updateFrameFromInputs();});});qs('importFile').addEventListener('change',e=>{const file=e.target.files&&e.target.files[0];if(!file)return;const reader=new FileReader();reader.onload=()=>{qs('jsonText').value=String(reader.result||'');importJsonText();};reader.readAsText(file,'utf-8');});qs('jsonText').addEventListener('keydown',e=>{if(e.ctrlKey&&e.key==='Enter'){e.preventDefault();applyJsonEditor();}});}\n"
"function bindTemplateInputs(){['genKind','genSpeed','genSteps','genAmp','genRecover','genPause'].forEach(id=>{const el=qs(id);if(el){el.addEventListener('change',refreshTemplateForm);el.addEventListener('input',refreshTemplateForm);}});}\n"
"function getModelLogicalRange(key){const meta=getJointMeta(key);const min=absToLogical(meta.min_abs_deg??0,key);const max=absToLogical(meta.max_abs_deg??270,key);return {min:Math.min(min,max),max:Math.max(min,max)};}\n"
"function getSvgPoint(evt){const svg=qs('dogSvg');const pt=svg.createSVGPoint();pt.x=evt.clientX;pt.y=evt.clientY;const screenCtm=svg.getScreenCTM();if(!screenCtm){return null;}return pt.matrixTransform(screenCtm.inverse());}\n"
"function applyModelDrag(key,evt){const point=getSvgPoint(evt);const hip=MODEL_HIPS[key];if(!point||!hip){return;}const range=getModelLogicalRange(key);const viewLogical=(point.x-hip[0])/MODEL_X_SCALE;const logical=clamp(viewToLogical(viewLogical),range.min,range.max);const abs=logicalToAbs(logical,key);const f=currentFrame();f.s[key]=abs;setSliderPair(key,abs);renderAll();}\n"
"function bindModelDragging(){const svg=qs('dogSvg');JOINT_KEYS.forEach(k=>{[qs(k+'Leg'),qs(k+'Handle')].forEach(el=>{el.addEventListener('pointerdown',evt=>{evt.preventDefault();state.dragKey=k;svg.setPointerCapture(evt.pointerId);applyModelDrag(k,evt);});});});svg.addEventListener('pointermove',evt=>{if(!state.dragKey){return;}applyModelDrag(state.dragKey,evt);});const stopDrag=evt=>{if(evt&&state.dragKey){try{svg.releasePointerCapture(evt.pointerId);}catch(_err){}}state.dragKey=null;renderDogModel();};svg.addEventListener('pointerup',stopDrag);svg.addEventListener('pointercancel',stopDrag);svg.addEventListener('pointerleave',evt=>{if((evt.buttons||0)===0&&state.dragKey){stopDrag(evt);}});}\n"
"function speedPhaseMs(speed){return speed==='slow'?120:(speed==='fast'?62:88);}function speedTurnMs(speed){return speed==='slow'?420:(speed==='fast'?220:320);}function speedAmplitude(speed){return speed==='slow'?12:(speed==='fast'?24:18);}function forwardWave(sample,phaseOffset,push,recover){const max=12;let phase=(sample+phaseOffset)%max;const recoverSamples=3;const stanceSamples=max-recoverSamples;if(phase<recoverSamples){return Math.round(push-((push+recover)*phase)/(recoverSamples-1));}phase-=recoverSamples;return Math.round(-recover+((push+recover)*phase)/(stanceSamples-1));}\n"
"function estimateStepsFromSeconds(kind,speed,seconds){const phaseMs=speedPhaseMs(speed);const turnMs=speedTurnMs(speed);const cycleMs=(kind==='left'||kind==='right')?turnMs*2:((kind==='spin_left'||kind==='spin_right')?turnMs*10:phaseMs*4);return clamp(Math.round((Number(seconds)||0)*1000/Math.max(1,cycleMs)),1,32);}\n"
"function buildWaveSequence(kind,speed,steps,amp,recover,pause){const phaseMs=speedPhaseMs(speed);const seq=[];function towardMap(keys,ratio,minUs){const out=presetPulseMap('stand');keys.forEach(key=>{out[key]=towardCalibratePulse(key,ratio,minUs);});return out;}function awayMap(keys,ratio,minUs){const out=presetPulseMap('stand');keys.forEach(key=>{out[key]=awayFromCalibratePulse(key,ratio,minUs);});return out;}function mergeMaps(a,b){const out=presetPulseMap('stand');JOINT_KEYS.forEach(key=>{if(a&&a[key]!=null)out[key]=a[key];if(b&&b[key]!=null)out[key]=b[key];});return out;}if(kind==='left'||kind==='right'){const pushRatio=Math.max(0.18,Math.min(0.64,Number(amp||18)/40));const recRatio=Math.max(0.12,Math.min(pushRatio*0.5,Number(recover||8)/36));const outer=kind==='left'?['lf','lr']:['rf','rr'];const inner=kind==='left'?['rf','rr']:['lf','lr'];for(let i=0;i<Math.max(1,steps);i++){seq.push(buildPulseFrame(`${kind}-${i*2+1}`,mergeMaps(awayMap(outer,pushRatio,42),towardMap(inner,recRatio,24)),speedTurnMs(speed)+120,pause));seq.push(buildPulseFrame(`${kind}-${i*2+2}`,mergeMaps(towardMap(outer,recRatio,24),awayMap(inner,pushRatio,42)),speedTurnMs(speed)+120,pause));}return seq;}const swingRatio=Math.max(0.16,Math.min(0.34,Number(amp||18)/58));const driveRatio=Math.max(0.12,Math.min(0.26,swingRatio*0.72));const settleRatio=Math.max(0.08,Math.min(0.18,swingRatio*0.5));const diagA=['lf','rr'];const diagB=['rf','lr'];const reverse=kind==='back';function applyDiag(map,keys,toward,ratio,minUs){keys.forEach(key=>{map[key]=toward?towardCalibratePulse(key,ratio,minUs):awayFromCalibratePulse(key,ratio,minUs);});}function buildWalkFrame(name,aToward,aRatio,bToward,bRatio){const pose=presetPulseMap('stand');applyDiag(pose,diagA,reverse?!aToward:aToward,aRatio,20);applyDiag(pose,diagB,reverse?!bToward:bToward,bRatio,20);return buildPulseFrame(name,pose,phaseMs,pause);}for(let step=0;step<Math.max(1,steps);step++){seq.push(buildWalkFrame(`${kind}-${step+1}-1`,true,swingRatio,false,driveRatio));seq.push(buildWalkFrame(`${kind}-${step+1}-2`,true,settleRatio,false,swingRatio));seq.push(buildWalkFrame(`${kind}-${step+1}-3`,false,swingRatio,true,driveRatio));seq.push(buildWalkFrame(`${kind}-${step+1}-4`,false,settleRatio,true,swingRatio));}return seq;}\n"
"function buildSimpleTemplate(kind,speed,steps,amp,pause){const ratio=Math.max(0.18,Math.min(0.78,Number(amp||18)/38));const supportRatio=Math.max(0.16,ratio*0.5);if(kind==='init'){return [buildPulseFrame('init',presetPulseMap('init'),320,0)];}if(kind==='stand'){return [buildPulseFrame('stand',presetPulseMap('stand'),300,0)];}if(kind==='down'){const pose=presetPulseMap('stand');JOINT_KEYS.forEach(key=>{pose[key]=towardCalibratePulse(key,0.34,36);});return [buildPulseFrame('down',pose,340,0)];}if(kind==='nod'){return [buildPulseFrame('nod-1',{lf:towardCalibratePulse('lf',0.22,32),rf:towardCalibratePulse('rf',0.22,32),lr:presetPulseForJoint('stand','lr'),rr:presetPulseForJoint('stand','rr')},260,120),buildPulseFrame('nod-2',{lf:awayFromCalibratePulse('lf',0.12,20),rf:awayFromCalibratePulse('rf',0.12,20),lr:presetPulseForJoint('stand','lr'),rr:presetPulseForJoint('stand','rr')},240,100),buildPulseFrame('stand',presetPulseMap('stand'),220,0)];}if(kind==='swing'){return [buildPulseFrame('swing-1',{lf:awayFromCalibratePulse('lf',ratio,24),rf:towardCalibratePulse('rf',ratio,24),lr:towardCalibratePulse('lr',ratio,24),rr:awayFromCalibratePulse('rr',ratio,24)},320,120),buildPulseFrame('swing-2',{lf:towardCalibratePulse('lf',ratio,24),rf:awayFromCalibratePulse('rf',ratio,24),lr:awayFromCalibratePulse('lr',ratio,24),rr:towardCalibratePulse('rr',ratio,24)},320,120),buildPulseFrame('stand',presetPulseMap('stand'),260,0)];}if(kind==='flip'){return [buildPulseFrame('flip-load-1',{lf:awayFromCalibratePulse('lf',0.18,28),rf:awayFromCalibratePulse('rf',0.18,28),lr:towardCalibratePulse('lr',0.24,28),rr:towardCalibratePulse('rr',0.24,28)},140,0),buildPulseFrame('flip-load-2',{lf:awayFromCalibratePulse('lf',0.32,54),rf:awayFromCalibratePulse('rf',0.32,54),lr:towardCalibratePulse('lr',0.42,54),rr:towardCalibratePulse('rr',0.42,54)},160,0),buildPulseFrame('flip-upside',{lf:awayFromCalibratePulse('lf',0.62,84),rf:awayFromCalibratePulse('rf',0.62,84),lr:awayFromCalibratePulse('lr',0.62,84),rr:awayFromCalibratePulse('rr',0.62,84)},220,40),buildPulseFrame('stand',presetPulseMap('stand'),180,0)];}if(kind==='wave_left'){return [buildPulseFrame('wave-left-load',{lf:towardCalibratePulse('lf',0.4,62),rf:presetPulseForJoint('stand','rf'),lr:awayFromCalibratePulse('lr',supportRatio,28),rr:awayFromCalibratePulse('rr',supportRatio,28)},200,90),buildPulseFrame('wave-left-peak',{lf:towardCalibratePulse('lf',0.84,112),rf:presetPulseForJoint('stand','rf'),lr:awayFromCalibratePulse('lr',supportRatio,28),rr:awayFromCalibratePulse('rr',supportRatio,28)},240,Math.max(180,pause)),buildPulseFrame('wave-left-mid',{lf:towardCalibratePulse('lf',0.58,74),rf:presetPulseForJoint('stand','rf'),lr:awayFromCalibratePulse('lr',supportRatio,28),rr:awayFromCalibratePulse('rr',supportRatio,28)},180,90),buildPulseFrame('wave-left-peak-2',{lf:towardCalibratePulse('lf',0.88,120),rf:presetPulseForJoint('stand','rf'),lr:awayFromCalibratePulse('lr',supportRatio,28),rr:awayFromCalibratePulse('rr',supportRatio,28)},240,Math.max(180,pause)),buildPulseFrame('stand',presetPulseMap('stand'),180,0)];}if(kind==='wave_right'){return [buildPulseFrame('wave-right-load',{lf:presetPulseForJoint('stand','lf'),rf:towardCalibratePulse('rf',0.4,62),lr:awayFromCalibratePulse('lr',supportRatio,28),rr:awayFromCalibratePulse('rr',supportRatio,28)},200,90),buildPulseFrame('wave-right-peak',{lf:presetPulseForJoint('stand','lf'),rf:towardCalibratePulse('rf',0.84,112),lr:awayFromCalibratePulse('lr',supportRatio,28),rr:awayFromCalibratePulse('rr',supportRatio,28)},240,Math.max(180,pause)),buildPulseFrame('wave-right-mid',{lf:presetPulseForJoint('stand','lf'),rf:towardCalibratePulse('rf',0.58,74),lr:awayFromCalibratePulse('lr',supportRatio,28),rr:awayFromCalibratePulse('rr',supportRatio,28)},180,90),buildPulseFrame('wave-right-peak-2',{lf:presetPulseForJoint('stand','lf'),rf:towardCalibratePulse('rf',0.88,120),lr:awayFromCalibratePulse('lr',supportRatio,28),rr:awayFromCalibratePulse('rr',supportRatio,28)},240,Math.max(180,pause)),buildPulseFrame('stand',presetPulseMap('stand'),180,0)];}if(kind==='shake_left'){return [buildPulseFrame('shake-left-load',{lf:towardCalibratePulse('lf',0.46,66),rf:presetPulseForJoint('stand','rf'),lr:awayFromCalibratePulse('lr',supportRatio,28),rr:awayFromCalibratePulse('rr',supportRatio,28)},200,90),buildPulseFrame('shake-left-pump-1',{lf:towardCalibratePulse('lf',0.72,92),rf:presetPulseForJoint('stand','rf'),lr:awayFromCalibratePulse('lr',supportRatio,28),rr:awayFromCalibratePulse('rr',supportRatio,28)},140,50),buildPulseFrame('shake-left-pump-2',{lf:towardCalibratePulse('lf',0.54,70),rf:presetPulseForJoint('stand','rf'),lr:awayFromCalibratePulse('lr',supportRatio,28),rr:awayFromCalibratePulse('rr',supportRatio,28)},140,50),buildPulseFrame('shake-left-pump-3',{lf:towardCalibratePulse('lf',0.8,104),rf:presetPulseForJoint('stand','rf'),lr:awayFromCalibratePulse('lr',supportRatio,28),rr:awayFromCalibratePulse('rr',supportRatio,28)},140,50),buildPulseFrame('stand',presetPulseMap('stand'),180,0)];}if(kind==='shake_right'){return [buildPulseFrame('shake-right-load',{lf:presetPulseForJoint('stand','lf'),rf:towardCalibratePulse('rf',0.46,66),lr:awayFromCalibratePulse('lr',supportRatio,28),rr:awayFromCalibratePulse('rr',supportRatio,28)},200,90),buildPulseFrame('shake-right-pump-1',{lf:presetPulseForJoint('stand','lf'),rf:towardCalibratePulse('rf',0.72,92),lr:awayFromCalibratePulse('lr',supportRatio,28),rr:awayFromCalibratePulse('rr',supportRatio,28)},140,50),buildPulseFrame('shake-right-pump-2',{lf:presetPulseForJoint('stand','lf'),rf:towardCalibratePulse('rf',0.54,70),lr:awayFromCalibratePulse('lr',supportRatio,28),rr:awayFromCalibratePulse('rr',supportRatio,28)},140,50),buildPulseFrame('shake-right-pump-3',{lf:presetPulseForJoint('stand','lf'),rf:towardCalibratePulse('rf',0.8,104),lr:awayFromCalibratePulse('lr',supportRatio,28),rr:awayFromCalibratePulse('rr',supportRatio,28)},140,50),buildPulseFrame('stand',presetPulseMap('stand'),180,0)];}if(kind==='walk'||kind==='back'||kind==='left'||kind==='right'){let seq=buildWaveSequence(kind,speed,Math.max(1,steps),amp,Number(qs('genRecover').value||Math.max(8,Math.round(amp/2))),pause);seq.push(buildPulseFrame('stand',presetPulseMap('stand'),180,0));return seq;}if(kind==='spin_left'){let seq=buildWaveSequence('left',speed,Math.max(1,steps)*4,amp,Number(qs('genRecover').value||Math.max(8,Math.round(amp/2))),pause);seq.push(buildPulseFrame('stand',presetPulseMap('stand'),180,0));return seq;}if(kind==='spin_right'){let seq=buildWaveSequence('right',speed,Math.max(1,steps)*4,amp,Number(qs('genRecover').value||Math.max(8,Math.round(amp/2))),pause);seq.push(buildPulseFrame('stand',presetPulseMap('stand'),180,0));return seq;}if(kind==='serve_left'){return [buildPulseFrame('serve-left-load',{lf:towardCalibratePulse('lf',0.58,84),rf:presetPulseForJoint('stand','rf'),lr:awayFromCalibratePulse('lr',supportRatio,28),rr:awayFromCalibratePulse('rr',supportRatio,28)},220,90),buildPulseFrame('serve-left-windup',{lf:towardCalibratePulse('lf',0.72,108),rf:presetPulseForJoint('stand','rf'),lr:awayFromCalibratePulse('lr',supportRatio,28),rr:awayFromCalibratePulse('rr',supportRatio,28)},160,50),buildPulseFrame('serve-left-press',{lf:awayFromCalibratePulse('lf',0.34,58),rf:presetPulseForJoint('stand','rf'),lr:awayFromCalibratePulse('lr',supportRatio*0.7,20),rr:awayFromCalibratePulse('rr',supportRatio*0.7,20)},160,Math.max(100,pause)),buildPulseFrame('stand',presetPulseMap('stand'),180,0)];}if(kind==='serve_right'){return [buildPulseFrame('serve-right-load',{lf:presetPulseForJoint('stand','lf'),rf:towardCalibratePulse('rf',0.58,84),lr:awayFromCalibratePulse('lr',supportRatio,28),rr:awayFromCalibratePulse('rr',supportRatio,28)},220,90),buildPulseFrame('serve-right-windup',{lf:presetPulseForJoint('stand','lf'),rf:towardCalibratePulse('rf',0.72,108),lr:awayFromCalibratePulse('lr',supportRatio,28),rr:awayFromCalibratePulse('rr',supportRatio,28)},160,50),buildPulseFrame('serve-right-press',{lf:presetPulseForJoint('stand','lf'),rf:awayFromCalibratePulse('rf',0.34,58),lr:awayFromCalibratePulse('lr',supportRatio*0.7,20),rr:awayFromCalibratePulse('rr',supportRatio*0.7,20)},160,Math.max(100,pause)),buildPulseFrame('stand',presetPulseMap('stand'),180,0)];}return buildWaveSequence(kind,speed,steps,amp,Number(qs('genRecover').value||Math.max(8,Math.round(amp/2))),pause);}\n"
"function generateSequence(kind,speed,steps,amp,pause){return buildSimpleTemplate(kind,speed,steps,amp,pause);}\n"
"function parsePrompt(text){text=String(text||'').trim();if(!text){return null;}let kind='stand';if(/翻跟斗|翻滚|打滚/.test(text))kind='flip';else if(/原地.*左.*旋|左.*原地.*旋|原地左转|左旋|左自转|左转圈/.test(text))kind='spin_left';else if(/原地.*右.*旋|右.*原地.*旋|原地右转|右旋|右自转|右转圈/.test(text))kind='spin_right';else if(/握手/.test(text))kind=/左前|左手|左/.test(text)?'shake_left':'shake_right';else if(/招手|挥手/.test(text))kind=/左前|左手|左/.test(text)?'wave_left':'wave_right';else if(/发球|网球/.test(text))kind=/左前|左手|左/.test(text)?'serve_left':'serve_right';else if(/校正|初始化|校正位置|装配位|伸直/.test(text))kind='init';else if(/前进|走/.test(text))kind='walk';else if(/后退|后撤/.test(text))kind='back';else if(/左转/.test(text))kind='left';else if(/右转/.test(text))kind='right';else if(/点头/.test(text))kind='nod';else if(/摆|摇/.test(text))kind='swing';else if(/趴|低/.test(text))kind='down';else if(/站立|站好|站起来|站立模式|回站立|站立复位|回正|回中|归中|归位|复位/.test(text))kind='stand';const appendStand=/回站立|站立复位|回正|回中|归中|归位|复位/.test(text)&&kind!=='stand';const stepMatch=text.match(/(\\d+)\\s*步/);const secondMatch=text.match(/(\\d+(?:\\.\\d+)?)\\s*秒/);const ampMatch=text.match(/(\\d+)\\s*度/);let speed=/慢|slow/.test(text)?'slow':(/快|fast/.test(text)?'fast':'normal');let steps=stepMatch?Number(stepMatch[1]):Number(qs('genSteps').value||5);let amp=ampMatch?Number(ampMatch[1]):Number(qs('genAmp').value||18);if(secondMatch){steps=estimateStepsFromSeconds(kind,speed,Number(secondMatch[1]));}if(/小摆幅|轻微|柔和/.test(text))amp=Math.min(amp,12);if(/大摆幅|夸张|用力/.test(text))amp=Math.max(amp,24);return {kind,speed,steps,amp,pause:Number(qs('genPause').value||0),seconds:secondMatch?Number(secondMatch[1]):0,appendStand};}\n"
"function loadFrames(frames,append){if(!append){state.frames=frames.length?frames:[defaultFrame('frame-1')];state.selected=0;}else{state.frames=state.frames.concat(frames);}renderAll();}\n"
"function generateFromControls(){const kind=qs('genKind').value;const speed=qs('genSpeed').value;const steps=clamp(qs('genSteps').value,1,32);const amp=clamp(qs('genAmp').value,6,36);const pause=clamp(qs('genPause').value,0,1000);state.generated=generateSequence(kind,speed,steps,amp,pause);loadFrames(state.generated,false);setOut('已按参数生成关键帧草稿');}\n"
"function generateFromPrompt(){const parsed=parsePrompt(qs('promptText').value);if(!parsed){setOut('请输入描述后再生成');return;}state.generated=generateSequence(parsed.kind,parsed.speed,parsed.steps,parsed.amp,parsed.pause);if(parsed.appendStand){state.generated=state.generated.concat(generateSequence('stand',parsed.speed,1,parsed.amp,0));}loadFrames(state.generated,false);qs('genKind').value=parsed.kind;qs('genSpeed').value=parsed.speed;qs('genSteps').value=parsed.steps;qs('genAmp').value=parsed.amp;refreshTemplateForm();setOut(parsed.appendStand?`已按文本生成关键帧草稿，并在结尾追加回站立（${state.generated.length} 帧）`:parsed.seconds?`已按文本生成关键帧草稿（约 ${parsed.seconds} 秒，展开为 ${parsed.steps} 步）`:'已按文本生成关键帧草稿');}\n"
"function appendGenerated(){const parsed=parsePrompt(qs('promptText').value)||{kind:qs('genKind').value,speed:qs('genSpeed').value,steps:clamp(qs('genSteps').value,1,32),amp:clamp(qs('genAmp').value,6,36),pause:clamp(qs('genPause').value,0,1000),appendStand:false};let frames=generateSequence(parsed.kind,parsed.speed,parsed.steps,parsed.amp,parsed.pause);if(parsed.appendStand){frames=frames.concat(generateSequence('stand',parsed.speed,1,parsed.amp,0));}loadFrames(frames,true);setOut(parsed.appendStand?'已把生成结果追加到当前序列，并在结尾追加回站立':'已把生成结果追加到当前序列');}\n"
"async function runTemplateNow(){const kind=qs('genKind').value;const speed=qs('genSpeed').value||'normal';const steps=clamp(qs('genSteps').value,1,32);generateFromControls();if(shouldRunViaNative(kind)){await runNamedAction(kind,steps,speed);return;}await sendSequence('all');}\n"
"async function runPromptNow(){const text=String(qs('promptText').value||'').trim();if(!text){setOut('请输入描述后再运行');return;}const parsed=parsePrompt(text);generateFromPrompt();if(parsed&&shouldRunViaNative(parsed.kind)){await runNamedAction(parsed.kind,parsed.steps,parsed.speed||'normal');return;}await sendSequence('all');}\n"
"async function queryStatus(){try{const res=await fetch('/api/dog/status');const data=await res.json();state.status=data;if(data&&data.ready&&data.current){state.meta=Object.assign({},state.meta||{}, {ready:true,current:data.current});renderAll();}setOut(data);}catch(err){setOut('查询失败: '+err);}}\n"
"async function refreshDeviceMeta(){try{const res=await fetch('/api/dog/meta');const data=await res.json();if((!data||!data.ready)&&state.meta&&state.meta.ready){data.ready=true;data.current=data.current||state.meta.current;}const shouldResetHome=!state.frames.length||(state.frames.length===1&&state.frames[0]&&(state.frames[0].name==='home'||state.frames[0].name==='stand'));state.meta=data;state.status=Object.assign({},state.status||{}, {ready:data.ready,current:data.current});applySliderMeta();if(shouldResetHome){clearToHome();}else{renderAll();}setOut('设备元数据已刷新');}catch(err){setOut('读取设备元数据失败: '+err);}}\n"
"function loadCurrentPoseFrame(){const abs=(state.meta&&state.meta.current&&state.meta.current.abs)||defaultStandPose();state.frames=[{name:'device-current',s:{lf:abs.lf,rf:abs.rf,lr:abs.lr,rr:abs.rr},v:300,d:0}];state.selected=0;renderAll();setOut('已载入设备当前姿态');}\n"
"async function showControlPageHint(){try{const res=await fetch('/api/dog/show_page');const data=await res.json();setOut(data);}catch(err){setOut('屏幕显示地址失败: '+err);}}\n"
"async function sendSequence(scope){scope=scope||getExecutionScope();const frames=getExecutionFrames(scope);const text=JSON.stringify(buildSequenceObject(frames));const bodyBytes=(new Blob([text])).size;const bodyMax=Number(state.meta&&state.meta.sequence_body_max||0);if(bodyMax>0&&bodyBytes>bodyMax){setOut(`发送失败: ${getExecutionScopeLabel(scope)}共 ${frames.length} 帧，JSON 大小 ${bodyBytes} bytes，超过设备上限 ${bodyMax} bytes。请减少帧数，或合并相邻静止帧。`);return;}try{const res=await fetch('/api/dog/sequence',{method:'POST',headers:{'Content-Type':'application/json'},body:text});const raw=await res.text();let data;try{data=raw?JSON.parse(raw):{ok:res.ok,status:res.status};}catch(_err){data={ok:res.ok,status:res.status,body:raw};}if(!res.ok){setOut(data&&data.msg?`发送失败: ${data.msg}${data.body_max?` (body ${bodyBytes}/${data.body_max} bytes)`:''}`:`发送失败: HTTP ${res.status}`);return;}setOut(typeof data==='object'&&data?Object.assign({scope:getExecutionScopeLabel(scope),frames:frames.length},data):data);}catch(err){setOut(`发送失败: ${err}；${getExecutionScopeLabel(scope)} ${frames.length} 帧，JSON ${bodyBytes} bytes${bodyMax>0?`，设备上限 ${bodyMax} bytes`:''}`);}}\n"
"function stopPreview(){if(state.playTimer){clearTimeout(state.playTimer);state.playTimer=null;}}\n"
"function playPreview(scope){stopPreview();scope=scope||getExecutionScope();const sourceFrames=getExecutionFrames(scope);if(!sourceFrames.length)return;const baseIndex=state.selected;let idx=0;const tick=()=>{if(scope==='all'){state.selected=idx;renderAll();}else{const f=sourceFrames[0];qs('modelText').textContent=`当前预览: ${getExecutionScopeLabel(scope)} | ${f.name||'frame'} | 逻辑角: LF ${absToLogical(f.s.lf,'lf')} / RF ${absToLogical(f.s.rf,'rf')} / LR ${absToLogical(f.s.lr,'lr')} / RR ${absToLogical(f.s.rr,'rr')}`;JOINT_KEYS.forEach(k=>setSliderPair(k,f.s[k]));}const f=sourceFrames[idx];if(scope==='current'){const prev=state.frames[state.selected];state.frames[state.selected]=deepCopy(f);renderDogModel();renderThreeDog();state.frames[state.selected]=prev;idx=0;}else{idx=(idx+1)%sourceFrames.length;}state.playTimer=setTimeout(tick,Math.max(40,(f.v||300)+(f.d||0)));};tick();setOut(`开始预览：${getExecutionScopeLabel(scope)}（${sourceFrames.length} 帧）`);if(scope==='current'){state.selected=baseIndex;}}\n"
"initThreePreview();bindFrameInputs();bindTemplateInputs();bindModelDragging();clearToHome();refreshTemplateForm();refreshDeviceMeta();queryStatus();\n"
"</script>\n"
"</body>\n"
"</html>\n"
